## uboot-imx-rel_imx_4.1.15_2.1.0_ga/board/freescale/mx6ull_glxadd_emmc/Kconfig
```kconfig
if TARGET_MX6ULL_14X14_GLXADD_EMMC

config SYS_BOARD
	default "mx6ull_glxadd_emmc"

config SYS_VENDOR
	default "freescale"

config SYS_CONFIG_NAME
	default "mx6ull_glxadd_emmc"

endif
```

## uboot-imx-rel_imx_4.1.15_2.1.0_ga/configs/mx6ull_14x14_glxadd_emmc_defconfig
```kconfig
#add by glx设置为自己新建的板级文件
CONFIG_SYS_EXTRA_OPTIONS="IMX_CONFIG=board/freescale/mx6ull_glxadd_emmc/imximage.cfg,MX6ULL_EVK_EMMC_REWORK"
CONFIG_ARM=y
CONFIG_ARCH_MX6=y
CONFIG_TARGET_MX6ULL_14X14_GLXADD_EMMC=y
CONFIG_CMD_GPIO=y
```
